## CMakeLists.txt
```
cmake_minimum_required(VERSION 3.20.0)
set(BOARD esp32c6_devkitc)
find_package(Zephyr REQUIRED HINTS $ENV{ZEPHYR_BASE})
project(GreenEdge)

target_include_directories(app PRIVATE include)

target_sources(app PRIVATE 
	src/main.c
	src/sensor.c
	src/sensor_thread.c
	src/shell_cmds.c
)
```

## west.yml
```
manifest:
  remotes:
    - name: zephyrproject-rtos
      url-base: https://github.com/zephyrproject-rtos
  projects:
    - name: zephyr
      remote: zephyrproject-rtos
      revision: v4.3.0
      path: zephyr
      import:
        path-prefix: deps
  self:
    path: .
```

## prj.conf
```kconfig
CONFIG_SERIAL=y
CONFIG_SHELL=y

CONFIG_CONSOLE=y
CONFIG_LOG_CMDS=y
CONFIG_LOG=y

#Sensors
CONFIG_W1=y
CONFIG_SENSOR=y

# Configuraciones específicas para ESP32-C6
CONFIG_GPIO=y
CONFIG_SENSOR_LOG_LEVEL_DBG=y

#Shell
#
```

## app.overlay
```dts
#include <dt-bindings/gpio/gpio.h>

/ {
    compatible = "espressif,esp32c6-devkitm";

    ds18b20 {
        compatible = "maxim,ds18b20";
        family-code = <0x28>;
        gpios = <&gpio0 4 GPIO_ACTIVE_HIGH>; /* Mismo GPIO que en onewire */
        status = "okay";
    };
};
```

## src/main.c
```c
#include <zephyr/kernel.h>
#include <zephyr/logging/log.h>
#include "sensors.h"
#include "sensor_thread.h"

LOG_MODULE_REGISTER(app, LOG_LEVEL_INF);

int main(void)
{
    LOG_INF("GreenEdge starting");

    sensor_thread_start();

    return 0;
}
```

## include/sensors.h
```c
/**
 * @file sensors.h
 * @brief Sensor data management interface
 * 
 * This module provides thread-safe access to sensor data
 */

#ifndef SENSORS_H
#define SENSORS_H

#include <stdint.h>

/**
 * @brief Sensor data structure
 */
struct sensor_data {
    int temperature;  /**< Temperature in Celsius */
    int humidity;     /**< Humidity in percentage */
};

/**
 * @brief Initialize sensor subsystem
 * 
 * Must be called before any other sensor function
 */
void sensors_init(void);

/**
 * @brief Read current sensor values (simulated)
 * 
 * This function updates the internal sensor state.
 * Thread-safe when called from sensor thread.
 * 
 * @param data Pointer to sensor data structure to update
 */
void sensors_read(void);

/**
 * @brief Get current sensor values (thread-safe)
 * 
 * This function provides thread-safe access to sensor data
 * from any context (shell, other threads, etc.)
 * 
 * @param data Pointer to sensor data structure to fill
 */
void sensors_get(struct sensor_data *data);

/**
 * @brief Trigger a sensor reading
 * 
 * Wakes up the sensor thread to perform a new reading
 */
void sensors_trigger_read(void);

#endif /* SENSORS_H */
```

## src/sensor.c
```c
/**
 * @file sensor.c
 * @brief Sensor data management implementation
 */

#include <zephyr/kernel.h>
#include <zephyr/logging/log.h>
#include "sensors.h"

LOG_MODULE_REGISTER(sensors, LOG_LEVEL_DBG);

/* Private data - only accessed through public API */
static struct sensor_data sensors;
static struct k_mutex sensors_mutex;

void sensors_init(void)
{
    k_mutex_init(&sensors_mutex);

    /* Initialize with default values */
    k_mutex_lock(&sensors_mutex, K_FOREVER);
    sensors.temperature = 20;
    sensors.humidity = 50;
    k_mutex_unlock(&sensors_mutex);

    LOG_INF("Sensors initialized (T=%d, H=%d)", 
            sensors.temperature, sensors.humidity);
}

void sensors_read(void)
{
    /* Simulate sensor reading with incremental values */
    sensors.temperature += 1;
    sensors.humidity += 2;

    /* Wrap around to simulate realistic sensor behavior */
    if (sensors.temperature > 30) {
        sensors.temperature = 20;
    }

    if (sensors.humidity > 80) {
        sensors.humidity = 50;
    }

    LOG_DBG("Sensor read: T=%d, H=%d", sensors.temperature, sensors.humidity);
}

void sensors_get(struct sensor_data *data)
{
    if (data == NULL) {
        LOG_ERR("NULL pointer passed to sensors_get");
        return;
    }

    k_mutex_lock(&sensors_mutex, K_FOREVER);
    data->temperature = sensors.temperature;
    data->humidity = sensors.humidity;
    k_mutex_unlock(&sensors_mutex);
}
```
